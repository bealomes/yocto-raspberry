## build/conf/bblayers.conf
```bitbake
# POKY_BBLAYERS_CONF_VERSION is increased each time build/conf/bblayers.conf
# changes incompatibly
POKY_BBLAYERS_CONF_VERSION = "2"

BBPATH = "${TOPDIR}"
BBFILES ?= ""

BBLAYERS ?= " \
  /home/bealomes/Documentos/Faculdade/mini-distro-yocto/source/poky/meta \
  /home/bealomes/Documentos/Faculdade/mini-distro-yocto/source/poky/meta-poky \
  /home/bealomes/Documentos/Faculdade/mini-distro-yocto/source/poky/meta-yocto-bsp \
  "
```
